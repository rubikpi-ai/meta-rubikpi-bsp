## conf/layer.conf
```bitbake
# We have a conf and classes directory, add to BBPATH
BBPATH .= ":${LAYERDIR}"

# We have a packages directory, add to BBFILES
BBFILES += "${LAYERDIR}/recipes-*/*/*.bb \
            ${LAYERDIR}/recipes-*/*/*.bbappend"

BBFILE_COLLECTIONS      += "qcom-hwe"
BBFILE_PATTERN_qcom-hwe   = "^${LAYERDIR}/"
BBFILE_PRIORITY_qcom-hwe  = "6"

LAYERDEPENDS_qcom-hwe = "qcom"
LAYERSERIES_COMPAT_qcom-hwe = "scarthgap"

LICENSE_PATH += "${LAYERDIR}/files/common-licenses"

BBFILES_DYNAMIC += " \
    openembedded-layer:${LAYERDIR}/dynamic-layers/openembedded-layer/*/*/*.bb \
    openembedded-layer:${LAYERDIR}/dynamic-layers/openembedded-layer/*/*/*.bbappend \
    selinux:${LAYERDIR}/dynamic-layers/selinux/*/*/*.bb \
    selinux:${LAYERDIR}/dynamic-layers/selinux/*/*/*.bbappend \
    sota:${LAYERDIR}/dynamic-layers/sota/*/*/*.bb \
    sota:${LAYERDIR}/dynamic-layers/sota/*/*/*.bbappend \
    virtualization-layer:${LAYERDIR}/dynamic-layers/virtualization-layer/*/*/*.bb \
    virtualization-layer:${LAYERDIR}/dynamic-layers/virtualization-layer/*/*/*.bbappend \
"

QCOM_COMMON_LICENSE_DIR = "${@os.path.normpath("${LAYERDIR}")+'/files/common-licenses/'}"
```
